// SDPArduino - Version: Latest 
#include <SDPArduino.h>
#include <Wire.h>
#include <Rotary.h>
/*

  
- script used for line following
- uses an fsm to function
- used for debugging
- author: ilie, pieris

Motor movement directions

            + | - 

motor 1:    <-|->
motor 2:    fw|bw
motor 3:    <-|->
motor 4:    fw|bw


*/


//--------------------Globals-------------------

double Kp=0.01;
// double Ki;
double Kd=0.05;
int ERROR_calib=3500;

double motors_speed = 0;      // global used for speed of right mototrs
double line_last_error    = 0;      // global that holds last error from fwd sensors
double line_new_error     = 0;
double mottor_adjustment  = 0;      // global used to readjust mottor speed

double right_motors_default_speed = 50;    // global used as default speed of right motors
double left_motors_default_speed  = 50 ;   // global used as default speed of left motors
double right_max_speed = 100   ;           // max speed of right mototrs
double left_max_speed  = 100  ;            // max speed of left motors

double range_left=2500;
double range_right=5500;

double motor1_old=0;
double motor2_old=0;
double motor3_old=0;
double motor4_old=0;

double motor1_current=0;
double motor2_current=0;
double motor3_current=0;
double motor4_current=0;


int counter = 0;



//-------------------------------------------------------------------------------
//                           Movement functions
//-------------------------------------------------------------------------------
void motor_move(int id, double speed){
  Serial.println("INSIDE motor_move");
  if (speed>=0){
    motorForward(id,speed);
    Serial.print("FWD: id ");
    Serial.println(id);
    Serial.print("FWD: speed ");
    Serial.println(speed);
  }
  else{
    motorBackward(id,abs(speed));
    Serial.print("BKW: id ");
    Serial.println(id);
    Serial.print("BKW: speed ");
    Serial.println(speed);    
  }
  // delay(500);
}

void turn_left(int speed_input){
    double speed_input_horizontal;
    double speed_input_forward;
    if(abs(70 + speed_input)>100){
        speed_input_horizontal = 100;
    }
    else{
        speed_input_horizontal = speed_input + 70;
    }

    motor1_current=speed_input_horizontal;
    motor3_current=speed_input_horizontal;

    if(abs(50 + speed_input > 80)){
        speed_input_forward = 80;
    }
    else{
        speed_input_forward = 50 + speed_input;
    }
    
    if (check_change_rotation()==true){

        //Serial.println("ACTUALLY TURNING RIGHT WITH SPEED:",speed_input_horizontal)
        motor_move(1, -1*speed_input_horizontal);
        motor_move(2, -1*speed_input_forward);
        motor_move(3, -1*speed_input_horizontal);
        motor_move(4, -1*speed_input_forward);


        motor1_old=-1*speed_input_horizontal;
        motor2_old=-1*speed_input_forward;
        motor3_old=-1*speed_input_horizontal;
        motor4_old=-1*speed_input_forward;
    }
}



void turn_right(int speed_input){
    double speed_input_horizontal;
    double speed_input_forward;
    
    if(abs(70 + speed_input)>100){
        speed_input_horizontal = 100;
    }
    else{
        speed_input_horizontal = speed_input + 70;
    }

    motor1_current=speed_input_horizontal;
    motor3_current=speed_input_horizontal;

    if(abs(50 + speed_input > 80)){
      speed_input_forward = 80;
      
    }
    else{
      speed_input_forward = 50 + speed_input;
    }
    if (check_change_rotation()==true){
        //Serial.println("ACTUALLY TURNING LEFT WITH SPEED:",speed_input_horizontal)

        motor_move(1, speed_input_horizontal);
        motor_move(2, speed_input_forward);
        motor_move(3, speed_input_horizontal);
        motor_move(4, speed_input_forward);


        motor1_old=speed_input_horizontal;
        motor2_old=speed_input_forward;
        motor3_old=speed_input_horizontal;
        motor4_old=speed_input_forward;
    }
}
bool check_change_forward(){
    if((abs(motor2_old-motor2_current)>8) || (abs(motor4_old-motor4_current)>8)){
        motor2_old=motor2_current;
        motor4_old=motor4_current;
        return true;
    }
    else{
        return false;
    }
}
bool check_change_rotation(){
    if(abs(motor1_old-motor1_current)>8){
        motor1_old=motor1_current;
        motor3_old=motor3_current;
        return true;
    }
    else{
        return false;
    }

}

//////////////////////////////////////////////////////

void setup() {
  Serial.begin(9600);  // Serial at given baudrate
  Serial.println("Serial Print Initialized");
  SDPsetup();
  Wire.begin();  // Master of the I2C bus
}

void loop() {
  
    // motorForward(2,100);
    // delay(100);
    
    //get value from sensor
    int sensor_fwd_reading=1000;
    
    //calculate motor speed
    double motors_speed_old = motors_speed;
    line_new_error = sensor_fwd_reading - ERROR_calib;
    mottor_adjustment = Kp * line_new_error + Kd * (line_new_error - line_last_error);
    line_last_error = line_new_error;
    motors_speed = mottor_adjustment;

    // make sure you don't go over 100 
    if(motors_speed > 100){
        motors_speed = 100;
    }
    else if(motors_speed < -100){
        motors_speed = -100;
    }
    motors_speed=abs(motors_speed);

    
    
    //move motors
    if (sensor_fwd_reading < range_left){
        Serial.print("TURNING LEFT WITH SPEED:  ");
        Serial.println(motors_speed*3);
        
        motor1_current=motors_speed;
        motor3_current=motors_speed;
        
        turn_left(motors_speed);
    }
    else if(sensor_fwd_reading > range_right){
        Serial.print("TURNING RIGHT WITH SPEED: ");
        Serial.println(motors_speed);
        turn_right(motors_speed);
    }
    else if(sensor_fwd_reading>=range_left && sensor_fwd_reading<=range_right){
        Serial.println("MOVING FORWARD");
        motor2_current=70;
        motor4_current=70;
        
        if(check_change_forward()==true){
          motorStop(1);
          motorStop(3);
          motor_move(4,70);
          motor_move(2,70);
          
          
          Serial.println("INSIDE FORWARD");
          
          motor2_old=motor2_current;
          motor4_old=motor4_current;
          
          Serial.print("motor2_current");
          Serial.println(motor2_current);
          
          Serial.print("motor4_current");
          Serial.println(motor4_current);
        }
    }
    else{
      Serial.println("MOTORS DIDN'T WORK");
    }
    //go back to top (get sensor values)
}
